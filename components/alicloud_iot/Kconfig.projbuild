## components/alicloud_iot/Kconfig.projbuild
```kconfig
menu "Alibaba Cloud IoT"

    config EMBED_ALICLOUD_PRODUCT_KEY
        string "Product Key"
        default ""
        help
            Alibaba Cloud IoT product key (ProductKey from the device certificate).

    config EMBED_ALICLOUD_DEVICE_NAME
        string "Device Name"
        default ""
        help
            Alibaba Cloud IoT device name (DeviceName from the device certificate).

    config EMBED_ALICLOUD_DEVICE_SECRET
        string "Device Secret"
        default ""
        help
            Alibaba Cloud IoT device secret used for HMAC-SHA256 credential generation.
            Keep this value confidential.

endmenu
```

## components/alicloud_oss/Kconfig.projbuild
```kconfig
menu "Alibaba Cloud OSS"

    config EMBED_OSS_ACCESS_KEY_ID
        string "Access Key ID"
        default ""
        help
            Alibaba Cloud RAM Access Key ID with OSS read/write permissions.

    config EMBED_OSS_ACCESS_KEY_SECRET
        string "Access Key Secret"
        default ""
        help
            Alibaba Cloud RAM Access Key Secret.

    config EMBED_OSS_REGION
        string "Region identifier (e.g. oss-cn-hangzhou)"
        default "oss-cn-hangzhou"

    config EMBED_OSS_BUCKET
        string "Bucket name"
        default ""

    config EMBED_OSS_UPLOAD_QUEUE_DEPTH
        int "OssUploadService frame queue depth"
        range 1 8
        default 2
        help
            Frames buffered between CameraService and the OSS upload task.
            Shallow = lower latency / more drops under load.

endmenu
```

## components/crearts_iot/Kconfig.projbuild
```kconfig
menu "Embed Framework — Crearts IoT"

    config EMBED_CREARTS_IOT_PRODUCT_ID
        string "Product ID"
        default "home"
        help
            Stable product key used in MQTT username/client id and full topics
            (username = "{product}.{device}").

    config EMBED_CREARTS_IOT_DEVICE_ID
        string "Device ID"
        default "esp32-s3"
        help
            Unique device id within the product. Combined with product id as
            MQTT username and client_id.

    config EMBED_CREARTS_IOT_HOST
        string "MQTT broker host"
        default "192.168.1.100"
        help
            Hostname or IPv4 of the Crearts/RabbitMQ broker (no scheme).
            On device hardware use the LAN IP of the NAS/PC, not localhost.

    config EMBED_CREARTS_IOT_ACCESS_TOKEN
        string "Device access token"
        default ""
        help
            Token issued when the device is registered in the Crearts dashboard.
            Used as MQTT password (username is product.device).
            Set via menuconfig / sdkconfig — do not hardcode in source.

    config EMBED_CREARTS_IOT_USE_TLS
        bool "Use MQTT over TLS (mqtts / port 8883)"
        default n

    config EMBED_CREARTS_IOT_PORT
        int "MQTT port (0 = default 1883/8883)"
        default 0
        range 0 65535

    config EMBED_CREARTS_IOT_TOPIC_SHORT
        bool "Use short topics (v1/t, v1/a, ...)"
        default n
        help
            Prefer short topics for constrained devices. Disable for full
            iot/v1/{product}/{device}/... topics.

endmenu
```

## components/embed_extra/Kconfig.projbuild
```kconfig
menu "Embed Extra — Camera & MJPEG"

    choice EMBED_CAMERA_BOARD
        prompt "Camera board pinout"
        default EMBED_CAMERA_BOARD_FREENOVE_S3
        config EMBED_CAMERA_BOARD_FREENOVE_S3
            bool "FREENOVE ESP32-S3-WROOM CAM"
        config EMBED_CAMERA_BOARD_AITHINKER
            bool "AI-Thinker ESP32-CAM"
    endchoice

    config EMBED_CAMERA_XCLK_FREQ_HZ
        int "XCLK frequency (Hz)"
        default 10000000
        help
            Camera XCLK frequency. OV2640 typically works at 10-20 MHz.

    config EMBED_CAMERA_JPEG_QUALITY
        int "JPEG quality (1=best, 63=worst)"
        range 1 63
        default 10

    config EMBED_CAMERA_FB_COUNT
        int "Frame buffer count"
        range 1 4
        default 2
        help
            Number of DMA frame buffers. 2 enables double-buffering.

    config EMBED_CAMERA_CAPTURE_INTERVAL_MS
        int "Capture interval (ms)"
        range 10 1000
        default 50
        help
            Delay between successive captures. ~20 fps = 50 ms.

    config EMBED_MJPEG_PORT
        int "MJPEG HTTP server port"
        range 1 65535
        default 80

    config EMBED_MJPEG_QUEUE_DEPTH
        int "Frame queue depth (frames)"
        range 1 8
        default 2
        help
            Frames buffered for the HTTP sender. Shallow = lower latency.

    config EMBED_MJPEG_STACK_SIZE
        int "HTTP server task stack size (bytes)"
        default 8192

endmenu

menu "Embed Extra — LED strip (WS2812)"

    config EMBED_LED_STRIP
        bool "Enable LedStripService"
        default y
        help
            Multiple WS2812/SK6812 strips. Bind GPIO at runtime via attach()
            or RPC led_attach. No boot-time pin is reserved.

    config EMBED_LED_STRIP_MAX
        int "Max concurrent strips"
        depends on EMBED_LED_STRIP
        range 1 8
        default 4
        help
            Limited by RMT TX channels on the chip (ESP32-S3 typically 4).

    config EMBED_LED_STRIP_DEFAULT_BRIGHTNESS
        int "Default brightness when attach omits it (0-255)"
        depends on EMBED_LED_STRIP
        range 1 255
        default 32

endmenu
```

## components/thingsboard/Kconfig.projbuild
```kconfig
menu "Embed Framework — ThingsBoard"

    config EMBED_THINGSBOARD_HOST
        string "ThingsBoard MQTT host"
        default "thingsboard.cloud"
        help
            Hostname or IP of the ThingsBoard MQTT endpoint (no scheme).

    config EMBED_THINGSBOARD_ACCESS_TOKEN
        string "Device access token"
        default ""
        help
            Access Token credentials: used as MQTT username (password empty).
            Leave empty to disable ThingsBoard credential auto-wiring in demos.

    config EMBED_THINGSBOARD_USE_TLS
        bool "Use MQTT over TLS (mqtts / port 8883)"
        default n
        help
            When enabled, broker URI uses mqtts:// and default port 8883.
            Server verification uses the global CRT bundle in MqttService.

    config EMBED_THINGSBOARD_PORT
        int "MQTT port (0 = default 1883/8883)"
        default 0
        range 0 65535
        help
            Override MQTT port. 0 selects 1883 (plain) or 8883 (TLS).

    config EMBED_THINGSBOARD_TOPIC_SHORT
        bool "Use short topics (v2/...)"
        default y
        help
            Prefer ThingsBoard 3.5+ short topics (v2/t, v2/a, v2/r/...).
            Disable to use v1/devices/me/... topics.

endmenu
```
